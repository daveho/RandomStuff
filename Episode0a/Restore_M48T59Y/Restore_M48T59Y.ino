// Restore the contents of an M48T59Y.
// The values in the DATA array will be written
// to the NVRAM bytes of the M48T59Y.
// (Note that you can use the Dump_M48T59Y sketch
// to dump the contents of an M48T59Y.)

#include <avr/pgmspace.h>
#include <m48t59y.h>

static const uint8_t DATA[M48T59Y_FIRST_REG] PROGMEM = {
  // This is a dump from a Sun Blade 100
  0x0,0xFF,0x40,0x0,0x0,0x0,0x0,0x0,0x0,0x0,0x0,0x0,0x0,0x0,0x0,0x0,
  0x0,0x0,0x0,0x0,0x0,0x0,0x0,0x0,0x0,0x0,0x0,0x0,0x0,0x0,0x0,0x0,
  0x0,0x0,0x0,0x0,0x0,0x0,0x0,0x0,0x0,0x0,0x0,0x0,0x0,0x0,0x0,0x0,
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  0x0,0x0,0x0,0x0,0x14,0xFE,0x38,0x3B,0x0,0x0,0x0,0x0,0x0,0x0,0x0,0x0,
};

void setup() {
  m48t59y_init();
}

void restore() {
  Serial.println( "Clearing NVRAM..." );
  for ( uint16_t addr = 0; addr < M48T59Y_FIRST_REG; ++addr )
    m48t59y_write( addr, 0x00 );

  Serial.println( "Writing data to NVRAM..." );
  for ( uint16_t addr = 0; addr < M48T59Y_FIRST_REG; ++addr ) {
    uint8_t data;
    data = pgm_read_byte( &DATA[addr] );
    m48t59y_write( addr, data );
  }

  Serial.print( "Verifying data written to NVRAM..." );
  bool good = true;
  for ( uint16_t addr = 0; addr < M48T59Y_FIRST_REG; ++addr ) {
    uint8_t expected, data;
    expected = pgm_read_byte( &DATA[addr] );
    data = m48t59y_read( addr );
    if ( expected != data )
      good = false;
  }

  if ( good )
    Serial.println( "all bytes read back successfully!" );
  else
    Serial.println( "verification failed" );
}

void loop() {
  if ( (PINC & GO) == 0 ) {
    restore();
  }
}
